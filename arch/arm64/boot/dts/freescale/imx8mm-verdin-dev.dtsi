// SPDX-License-Identifier: GPL-2.0+ OR MIT
/*
 * Copyright 2020 Toradex
 */

#include "imx8mm-verdin-dahlia.dtsi"

&gpio_expander_21 {
	status = "okay";
};

&sound_card {
	simple-audio-card,routing =
		"Headphone Jack", "HPOUTL",
		"Headphone Jack", "HPOUTR",
		"IN2L", "Line In Jack",
		"IN2R", "Line In Jack",
		"Microphone Jack", "MICBIAS",
		"IN1L", "Microphone Jack",
		"IN1R", "Microphone Jack";
};
